## board/nextthing/chip/bootimg.its
```
/dts-v1/;
/ {
	description = "CHIP Pro Kernel, Ramdisk, FDT";
	#address-cells = <1>;
	images {
		kernel@1 {
			description = "chip-pro_4.4";
			data = /incbin/("../../../output/images/zImage");
			type = "kernel";
			arch = "arm";
			os = "linux";
			compression = "gzip";
			load = <4200000>;
			entry = <00000000>;
			hash@1 {
				algo = "md5";
			};
			hash@2 {
				algo = "sha1";
			};
		};
		ramdisk@1 {
			description = "buildroot_hash";
			data = /incbin/("../../../output/images/rootfs.cpio.gz");
			type = "ramdisk";
			arch = "arm";
			os = "linux";
			compression = "gzip";
			load = <4400000>;
			entry = <00000000>;
			hash@1 {
				algo = "sha1";
			};
		};
		fdt@1 {
			description = "";
			data = /incbin/("../../../output/images/ntc-gr8-crumb.dtb");
			type = "flat_dt";
			arch = "arm";
			compression = "none";
			load = <4300000>;
			entry = <00000000>;
			hash@1 {
				algo = "crc32";
			};
		};
	};
	configurations {
		default = "config@1";
		config@1 {
			description = "boot configuration";
			kernel = "kernel@1";
			ramdisk = "ramdisk@1";
			fdt = "fdt@1";
		};
	};
};
```

## configs/chippro_defconfig
```kconfig
BR2_arm=y
BR2_cortex_a8=y
BR2_ARM_EABIHF=y
BR2_ARM_INSTRUCTIONS_THUMB2=y
BR2_BACKUP_SITE="http://sources.buildroot.net/"
BR2_KERNEL_MIRROR="http://www.kernel.org/pub/"
BR2_LUAROCKS_MIRROR="http://luarocks.org/repositories/rocks"
BR2_CPAN_MIRROR="http://search.cpan.org/CPAN"
BR2_PACKAGE_OVERRIDE_FILE="$(TOPDIR)/local.mk"
BR2_TOOLCHAIN_EXTERNAL=y
BR2_ENABLE_LOCALE_PURGE=y
BR2_ENABLE_LOCALE_WHITELIST="C en_US"
BR2_TARGET_OPTIMIZATION="-pipe"
BR2_TARGET_GENERIC_HOSTNAME="chip"
BR2_TARGET_GENERIC_ROOT_PASSWD="root"
BR2_TARGET_GENERIC_GETTY_BAUDRATE_115200=y
BR2_ROOTFS_USERS_TABLES="board/nextthing/chip/users_table.txt"
BR2_ROOTFS_OVERLAY="board/nextthing/chip/overlay"
BR2_ROOTFS_POST_BUILD_SCRIPT="board/nextthing/chip/scripts/post-build.sh"
BR2_ROOTFS_POST_IMAGE_SCRIPT="board/nextthing/chip/scripts/post-image.sh"
BR2_ROOTFS_POST_SCRIPT_ARGS="\"Toshiba-SLC-4G-TC58NVG2S0H\""
BR2_LINUX_KERNEL=y
BR2_LINUX_KERNEL_CUSTOM_GIT=y
BR2_LINUX_KERNEL_CUSTOM_REPO_URL="https://github.com/NextThingCo/CHIP-linux.git"
BR2_LINUX_KERNEL_CUSTOM_REPO_VERSION="nextthing/4.4/chip"
BR2_LINUX_KERNEL_PATCH="board/nextthing/chip/patches/linux/"
BR2_LINUX_KERNEL_USE_CUSTOM_CONFIG=y
BR2_LINUX_KERNEL_CUSTOM_CONFIG_FILE="board/nextthing/chip/configs/linux.config"
BR2_LINUX_KERNEL_ZIMAGE=y
BR2_LINUX_KERNEL_DTS_SUPPORT=y
BR2_LINUX_KERNEL_INTREE_DTS_NAME="ntc-gr8-crumb"
BR2_PACKAGE_BUSYBOX_CONFIG="board/nextthing/chip/configs/busybox.config"
BR2_PACKAGE_MTD=y
BR2_TARGET_ROOTFS_CPIO=y
BR2_TARGET_ROOTFS_CPIO_LZO=y
BR2_TARGET_ROOTFS_CPIO_UIMAGE=y
BR2_TARGET_ROOTFS_TAR_GZIP=y
BR2_TARGET_ROOTFS_UBIFS=y
BR2_TARGET_ROOTFS_UBIFS_LEBSIZE=0x3f000
BR2_TARGET_ROOTFS_UBIFS_MINIOSIZE=0x1000
BR2_TARGET_ROOTFS_UBIFS_MAXLEBCNT=2000
BR2_TARGET_ROOTFS_UBIFS_OPTS="-j 774144"
BR2_TARGET_ROOTFS_UBI=y
BR2_TARGET_ROOTFS_UBI_PEBSIZE=0x40000
BR2_TARGET_ROOTFS_UBI_SUBSIZE=1024
BR2_TARGET_ROOTFS_UBI_USE_CUSTOM_CONFIG=y
BR2_TARGET_ROOTFS_UBI_CUSTOM_CONFIG_FILE="board/nextthing/chip/configs/ubinize.config"
BR2_TARGET_UBOOT=y
BR2_TARGET_UBOOT_BUILD_SYSTEM_KCONFIG=y
BR2_TARGET_UBOOT_CUSTOM_GIT=y
BR2_TARGET_UBOOT_CUSTOM_REPO_URL="https://github.com/nextthingco/chip-u-boot"
BR2_TARGET_UBOOT_CUSTOM_REPO_VERSION="ww/2016.01/next"
BR2_TARGET_UBOOT_BOARD_DEFCONFIG="chippro"
BR2_TARGET_UBOOT_FORMAT_CUSTOM=y
BR2_TARGET_UBOOT_FORMAT_CUSTOM_NAME="u-boot-dtb.bin"
BR2_TARGET_UBOOT_SPL=y
BR2_TARGET_UBOOT_SPL_NAME="u-boot-sunxi-with-spl.bin spl/sunxi-spl.bin spl/sunxi-spl-with-ecc.bin"
BR2_TARGET_UBOOT_ENVIMAGE=y
BR2_TARGET_UBOOT_ENVIMAGE_SOURCE="board/nextthing/chip/uboot-env"
BR2_TARGET_UBOOT_ENVIMAGE_SIZE="0x400000"
BR2_PACKAGE_HOST_DTC_OVERLAY=y
BR2_PACKAGE_HOST_SUNXI_TOOLS=y
```

## package/chip-mtd-utils/Config.in.host
```kconfig
config BR2_PACKAGE_HOST_CHIP_MTD_UTILS
	bool "CHIP specific host mtd, jffs2 and ubi/ubifs tools"
	help
	  Build mtd, jffs2 and ubi/ubifs tools

	  http://www.linux-mtd.infradead.org/
```

## package/fcctui/Config.in
```kconfig
config BR2_PACKAGE_FCCTUI
	bool "fcctui Radio Test Tool"
	select BR2_PACKAGE_IW
	select BR2_PACKAGE_NCURSES
	select BR2_PACKAGE_SCREEN
	select BR2_PACKAGE_STRESS
	select BR2_PACKAGE_WIRELESS_TOOLS
	help
		Scripts for FCC Radio Tests
```

## package/hwtest/Config.in
```kconfig
config BR2_PACKAGE_HWTEST
	bool "hwtest"
	select BR2_PACKAGE_STRESS
	select BR2_PACKAGE_LSHW
	select BR2_PACKAGE_I2C_TOOLS
	select BR2_PACKAGE_IW
	help
		Small script to do some hardware tests on CHIP

if BR2_PACKAGE_HWTEST

config BR2_PACKAGE_HWTEST_ON_BOOT
	bool "Run hwtest on boot"
	help
		Install boot script to run hwtest on boot, poweroff if failed

endif
```

## package/linux-deb/Config.in
```kconfig
comment "linux-deb needs a Linux kernel to be built"
	depends on !BR2_LINUX_KERNEL

config BR2_PACKAGE_LINUX_DEB
	bool "linux-deb"
	depends on BR2_LINUX_KERNEL
	select BR2_PACKAGE_WIRELESS_TOOLS
	help
	  The linux-deb package builds a .deb from the linux kernel source.

if BR2_PACKAGE_LINUX_DEB
choice
	prompt "Linux deb package maintainer configuration"
	default BR2_PACKAGE_LINUX_DEB_USE_MAINTAINER_FROM_GITCONFIG
	help
	  Select the source of the maintainer name and email address

config BR2_PACKAGE_LINUX_DEB_USE_MAINTAINER_FROM_GITCONFIG
	bool "Set maintainter using git user.name and user.email"

config BR2_PACKAGE_LINUX_DEB_USE_MAINTAINER_CUSTOM
	bool "Set maintainer using custom config"

endchoice

config BR2_PACKAGE_LINUX_DEB_MAINTAINER_CUSTOM_NAME
	string "Maintainer name"
	depends on BR2_PACKAGE_LINUX_DEB_USE_MAINTAINER_CUSTOM

config BR2_PACKAGE_LINUX_DEB_MAINTAINER_CUSTOM_EMAIL
	string "Maintainer email"
	depends on BR2_PACKAGE_LINUX_DEB_USE_MAINTAINER_CUSTOM

choice
	prompt "Linux deb package LOCALVERSION"
	default BR2_PACKAGE_LINUX_DEB_USE_USER_AS_LOCALVERSION
	help
	  Select the source of LOCALVERSION

config BR2_PACKAGE_LINUX_DEB_USE_USER_AS_LOCALVERSION
	bool "Set LOCALVERSION from $USER"

config BR2_PACKAGE_LINUX_DEB_USE_CUSTOM_LOCALVERSION
	bool "Set custom LOCALVERSION"

endchoice

config BR2_PACKAGE_LINUX_DEB_LOCALVERSION_CUSTOM
	string "Custom LOCALVERSION"
	depends on BR2_PACKAGE_LINUX_DEB_USE_CUSTOM_LOCALVERSION

endif
```
